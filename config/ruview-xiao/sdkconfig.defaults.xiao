## config/ruview-xiao/sdkconfig.defaults.xiao
```kconfig
# Plain Seeed XIAO ESP32-S3 SKU 113991114; upstream pin in source-lock.json.
CONFIG_ARIADNE_XIAO_PILOT=y
# CONFIG_DISPLAY_ENABLE is not set
# CONFIG_WASM_ENABLE is not set
# CONFIG_LED_GAMMA_VIZ is not set
# CONFIG_CSI_MOCK_ENABLED is not set
# CONFIG_CSI_NODE_MDNS is not set
# CONFIG_MDNS_ENABLE_CONSOLE_CLI is not set
CONFIG_EDGE_TIER=0
CONFIG_CSI_NODE_ID=0
CONFIG_CSI_WIFI_SSID=""
CONFIG_CSI_WIFI_PASSWORD=""
CONFIG_CSI_TARGET_IP="0.0.0.0"
CONFIG_CSI_TARGET_PORT=5005
CONFIG_ESP_CONSOLE_USB_SERIAL_JTAG=y
CONFIG_ESP_CONSOLE_SECONDARY_NONE=y
CONFIG_SPIRAM=y
CONFIG_SPIRAM_MODE_OCT=y
CONFIG_SPIRAM_TYPE_ESPPSRAM64=y
CONFIG_SPIRAM_SPEED_40M=y
CONFIG_ESPTOOLPY_FLASHMODE_DIO=y
CONFIG_ESPTOOLPY_FLASHFREQ_40M=y
# CONFIG_APP_COMPILE_TIME_DATE is not set
CONFIG_COMPILER_HIDE_PATHS_MACROS=y
CONFIG_APP_REPRODUCIBLE_BUILD=y
```
